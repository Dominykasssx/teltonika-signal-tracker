## esp32/servo-controller/main/Kconfig.projbuild
```kconfig
menu "Servo controller"

    config PROTO_BAUD_RATE
        int "USB serial baud rate"
        default 115200
        help
            Baud rate of UART0 (the USB-to-UART bridge). Must match the router setting.

    config SERVO_GPIO
        int "Servo signal GPIO"
        default 18
        range 0 33
        help
            GPIO driving the servo signal wire. Avoid strapping pins (0, 2, 5, 12, 15).

    config SERVO_TRAVEL_DEG
        int "Servo full travel (degrees)"
        default 180
        range 1 360
        help
            Angle reached at the maximum pulse width.

    config SERVO_MIN_PULSE_US
        int "Pulse width at 0 degrees (us)"
        default 500

    config SERVO_MAX_PULSE_US
        int "Pulse width at full travel (us)"
        default 2500

    config SERVO_MIN_ANGLE
        int "Mechanical minimum angle"
        default 0
        range 0 360
        help
            Hard lower limit enforced by the firmware. Set to what the platform can
            physically reach without binding or stressing cables.

    config SERVO_MAX_ANGLE
        int "Mechanical maximum angle"
        default 180
        range 0 360
        help
            Hard upper limit enforced by the firmware. Must not exceed SERVO_TRAVEL_DEG.

    config SERVO_MS_PER_60DEG
        int "Servo speed (ms per 60 degrees, under load)"
        default 250
        help
            Used to estimate how long a move takes, since the servo has no feedback.
            Use a conservative (slow) value for the loaded platform.

    config SERVO_SETTLE_MS
        int "Extra settle time per move (ms)"
        default 150

endmenu
```
